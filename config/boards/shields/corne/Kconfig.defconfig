## config/boards/shields/corne/Kconfig.defconfig
```kconfig
# Copyright (c) 2020 The ZMK Contributors
# SPDX-License-Identifier: MIT

config ZMK_BLE
	default y

config ZMK_USB
	default y

if SHIELD_CORNE_DONGLE

config ZMK_KEYBOARD_NAME
	default "The CORNE Dongle"

endif

if SHIELD_CORNE_LEFT || SHIELD_CORNE_RIGHT

config ZMK_SPLIT
	default y

endif



if SHIELD_CORNE_DONGLE 

config ZMK_SPLIT
	default y

config ZMK_SPLIT_BLE_ROLE_CENTRAL
	default y

endif
```

## config/west.yml
```yaml
# <--- default firmware base
manifest:
  remotes:
    - name: zmkfirmware
      url-base: https://github.com/zmkfirmware
  projects:
    - name: zmk
      remote: zmkfirmware
      revision: main
      import: app/west.yml
  self:
    path: config
# <--- support mouse base || https://gist.github.com/krissen/dd27082e7ab0575619c7a31f4d2ec7ae
# manifest:
#   remotes:
#     - name: zmkfirmware
#       url-base: https://github.com/ftc/
#   projects:
#     - name: zmk
#       remote: zmkfirmware
#       revision: mouse-ftc
#       import: app/west.yml
#   self:
#     path: config
```
