raise_layer { label = "RAISE";

// | ~     | !  | @  | #    | $     | %   | /**/ | ^     | &    | *    | (    | )   | BSPC |
// | CTRL  | F1 | F2 | F3   | F4    | F5  | /**/ | F6    | _    | +    | {    | }   | "|"  |
// | SHIFT | F7 | F8 | F9   | F10   | F11 | /**/ | F12   | HOME | PGDN | PGUP | END | DEL  |
//                   | LALT | LOWER | SPC | /**/ | ENTER | HELD | GUI  |

bindings = <
    &kp TILDE  &kp EXCL  &kp AT  &kp HASH  &kp DLLR   &kp PRCNT /**/ &kp CARET  &kp AMPS   &kp ASTERISK   &kp LPAR     &kp RPAR  &kp BSPC
    &kp LCTRL  &kp F1    &kp F2  &kp F3    &kp F4     &kp F5    /**/ &kp F6     &kp UNDER  &kp PLUS       &kp LBRC     &kp RBRC  &kp PIPE
    &kp LSHFT  &kp F7    &kp F8  &kp F9    &kp F10    &kp F11   /**/ &kp F12    &kp HOME   &kp PAGE_DOWN  &kp PAGE_UP  &kp END   &kp DEL
                                 &kp LALT  &mo LOWER  &kp SPACE /**/ &kp ENTER  &mo RAISE  &kp LGUI
>;};