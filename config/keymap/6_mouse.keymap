#define SC_L SCRL_LEFT
#define SC_D SCRL_DOWN
#define SC_U SCRL_UP
#define SC_R SCRL_RIGHT

#define MV_L MOVE_LEFT
#define MV_D MOVE_DOWN
#define MV_U MOVE_UP
#define MV_R MOVE_RIGHT

maus_layer {
    label = "MAUS";
    display-name = "MAUS";

    bindings = <
    //╭─────────────┬─────────────┬─────────────┬─────────────┬─────────────┬─────────────╮  ╭─────────────┬─────────────┬─────────────┬─────────────┬─────────────┬─────────────╮
        &none         &none         &none         &none         &none         &none            &none         &none         &none         &none         &none         &none
    //├─────────────┼─────────────┼─────────────┼─────────────┼─────────────┼─────────────┤  ├─────────────┼─────────────┼─────────────┼─────────────┼─────────────┼─────────────┤
        &kp LCTRL     &none         &none         &none         &none         &none            &none         &none         &msc SC_U     &msc SC_L     &mmv MV_U     &msc SC_R
    //├─────────────┼─────────────┼─────────────┼─────────────┼─────────────┼─────────────┤  ├─────────────┼─────────────┼─────────────┼─────────────┼─────────────┼─────────────┤
        &kp LSHFT     &none         &none         &none         &none         &none            &mkp MB5      &mkp MB4      &msc SC_D     &mmv MV_L     &mmv MV_D     &mmv MV_R
    //╰─────────────┴─────────────┴─────────────┼─────────────┼─────────────┼─────────────┤  ├─────────────┼─────────────┼─────────────┼─────────────┴─────────────┴─────────────╯
                                                  &mkp MB1      &mkp MB2      &mkp MB3         &mkp MB3      &mkp MB1      &mkp MB2
    //                                          ╰─────────────┴─────────────┴─────────────╯  ╰─────────────┴─────────────┴─────────────╯
    >;
};