extra_layer {
    label = "EXTRA";
    display-name = "EXTRA";

    bindings = <
    //╭─────────────┬─────────────┬─────────────┬─────────────┬─────────────┬─────────────╮  ╭─────────────┬─────────────┬─────────────┬─────────────┬─────────────┬─────────────╮
        &bt BT_SEL 0  &kp C_BRI_UP  &kp CAPS      &kp SLCK      &out OUT_TOG  &kp PSCRN        &rgb_ug RGB_ON  &rgb_ug RGB_OFF &rgb_ug RGB_EFF &rgb_ug RGB_EFR &none &none
    //├─────────────┼─────────────┼─────────────┼─────────────┼─────────────┼─────────────┤  ├─────────────┼─────────────┼─────────────┼─────────────┼─────────────┼─────────────┤
        &bt BT_SEL 1  &lng_eng      &lng_lt       &lng_ru       &none         &out OUT_BLE     &rgb_ug RGB_HUI &rgb_ug RGB_HUD &rgb_ug RGB_SPI &rgb_ug RGB_SPD &none &none
    //├─────────────┼─────────────┼─────────────┼─────────────┼─────────────┼─────────────┤  ├─────────────┼─────────────┼─────────────┼─────────────┼─────────────┼─────────────┤
        &bt BT_SEL 2  &kp C_BRI_DN  &kp C_AC_HOME &kp C_AL_MAIL &out OUT_TOG  &out OUT_USB     &rgb_ug RGB_SAI &rgb_ug RGB_SAD &rgb_ug RGB_BRI &rgb_ug RGB_BRD &none &none
    //╰─────────────┴─────────────┴─────────────┼─────────────┼─────────────┼─────────────┤  ├─────────────┼─────────────┼─────────────┼─────────────┴─────────────┴─────────────╯
                                                  &bt BT_SEL 3  &bt BT_SEL 4  &bt BT_SEL 5     &none         &none         &none
    //                                          ╰─────────────┴─────────────┴─────────────╯  ╰─────────────┴─────────────┴─────────────╯
    >;
};