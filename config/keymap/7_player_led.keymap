player_layer {
    label = "PLAYER";
    display-name = "PLAYER";

    bindings = <
    //╭─────────────┬─────────────┬─────────────┬─────────────┬─────────────┬─────────────╮  ╭─────────────┬─────────────┬─────────────┬─────────────┬─────────────┬─────────────╮
        &none         &none         &none         &none         &none         &none         &rgb_ug RGB_ON  &rgb_ug RGB_OFF &rgb_ug RGB_EFF &rgb_ug RGB_EFR &none    &none
    //├─────────────┼─────────────┼─────────────┼─────────────┼─────────────┼─────────────┤  ├─────────────┼─────────────┼─────────────┼─────────────┼─────────────┼─────────────┤
        &none         &none         &none         &kp C_PREV    &kp C_NEXT    &none         &rgb_ug RGB_HUI &rgb_ug RGB_HUD &rgb_ug RGB_SPI &rgb_ug RGB_SPD &none    &none
    //├─────────────┼─────────────┼─────────────┼─────────────┼─────────────┼─────────────┤  ├─────────────┼─────────────┼─────────────┼─────────────┼─────────────┼─────────────┤
        &none         &kp LGUI      &none         &kp C_VOL_DN  &kp C_VOL_UP  &none         &rgb_ug RGB_SAI &rgb_ug RGB_SAD &rgb_ug RGB_BRI &rgb_ug RGB_BRD &none    &none
    //╰─────────────┴─────────────┴─────────────┼─────────────┼─────────────┼─────────────┤  ├─────────────┼─────────────┼─────────────┼─────────────┴─────────────┴─────────────╯
                                                  &none         &none         &none            &none         &none         &none
    //                                          ╰─────────────┴─────────────┴─────────────╯  ╰─────────────┴─────────────┴─────────────╯
    >;
};