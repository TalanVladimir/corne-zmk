player_layer {
    label = "PLAYER";
    display-name = "PLAYER";

    bindings = <
    //╭─────────────┬─────────────┬─────────────┬─────────────┬─────────────┬─────────────╮  ╭─────────────┬─────────────┬─────────────┬─────────────┬─────────────┬─────────────╮
        &none         &none         &none         &none         &none         &none            &none         &none         &none         &none         &none         &none
    //├─────────────┼─────────────┼─────────────┼─────────────┼─────────────┼─────────────┤  ├─────────────┼─────────────┼─────────────┼─────────────┼─────────────┼─────────────┤
        &none         &none         &none         &kp C_PREV    &kp C_NEXT    &none            &none         &none         &none         &none         &none         &none
    //├─────────────┼─────────────┼─────────────┼─────────────┼─────────────┼─────────────┤  ├─────────────┼─────────────┼─────────────┼─────────────┼─────────────┼─────────────┤
        &none         &kp LGUI      &none         &kp C_VOL_DN  &kp C_VOL_UP  &none            &none         &none         &none         &none         &none         &none
    //╰─────────────┴─────────────┴─────────────┼─────────────┼─────────────┼─────────────┤  ├─────────────┼─────────────┼─────────────┼─────────────┴─────────────┴─────────────╯
                                                  &none         &none         &none            &none         &none         &none
    //                                          ╰─────────────┴─────────────┴─────────────╯  ╰─────────────┴─────────────┴─────────────╯
    >;
};