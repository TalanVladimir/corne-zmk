adjust_layer { label = "ADJUST";

// | RGB_ON  | RGB_HUI | RGB_SAI | RGB_BRI | RGB_SPI | RGB_EFF | /**/ |   |      |   |   |   |   |
// | RGB_OFF | RGB_HUD | RGB_SAD | RGB_BRD | RGB_SPD | RGB_EFR | /**/ |   |      |   |   |   |   |
// |         |         |         |         |         |         | /**/ |   |      |   |   |   |   |
//                               |         | HELD    |         | /**/ |   | HELD |   |

bindings = <
    &rgb_ug RGB_ON   &rgb_ug RGB_HUI  &rgb_ug RGB_SAI  &rgb_ug RGB_BRI  &rgb_ug RGB_SPI  &rgb_ug RGB_EFF /**/ &none  &none      &none  &none  &none  &none
    &rgb_ug RGB_OFF  &rgb_ug RGB_HUD  &rgb_ug RGB_SAD  &rgb_ug RGB_BRD  &rgb_ug RGB_SPD  &rgb_ug RGB_EFR /**/ &none  &none      &none  &none  &none  &none
    &none            &none            &none            &none            &none            &none           /**/ &none  &none      &none  &none  &none  &none
                                                       &none            &mo LOWER        &none           /**/ &none  &mo RAISE  &none
>;};