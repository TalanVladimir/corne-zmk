player_layer {
    label = "PLAYER";
    display-name = "PLAYER";

    bindings = <
    //╭─────────────┬─────────────┬─────────────┬─────────────┬─────────────┬─────────────╮  ╭─────────────┬─────────────┬─────────────┬─────────────┬─────────────┬─────────────╮
        &none         &none         &none         &kp LEFT      &kp RIGHT     &none            &none         &none         &none         &none         &none         &none
    //├─────────────┼─────────────┼─────────────┼─────────────┼─────────────┼─────────────┤  ├─────────────┼─────────────┼─────────────┼─────────────┼─────────────┼─────────────┤
        &kp LCTRL     &none         &none         &kp C_PREV    &kp C_NEXT    &none            &none         &none         &msc SC_U     &msc SC_L     &mmv MV_U     &msc SC_R
    //├─────────────┼─────────────┼─────────────┼─────────────┼─────────────┼─────────────┤  ├─────────────┼─────────────┼─────────────┼─────────────┼─────────────┼─────────────┤
        &kp LSHFT     &kp LGUI      &none         &kp C_VOL_DN  &kp C_VOL_UP  &none            &mkp MB5      &mkp MB4      &msc SC_D     &mmv MV_L     &mmv MV_D     &mmv MV_R
    //╰─────────────┴─────────────┴─────────────┼─────────────┼─────────────┼─────────────┤  ├─────────────┼─────────────┼─────────────┼─────────────┴─────────────┴─────────────╯
                                                  &none         &none         &none            &mkp MB3      &mkp MB1      &mkp MB2
    //                                          ╰─────────────┴─────────────┴─────────────╯  ╰─────────────┴─────────────┴─────────────╯
    >;
};