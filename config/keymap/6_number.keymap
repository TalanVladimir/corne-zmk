number_layer { label = "NUMBER";

// | NLOCK | 1 | 2 | 3    | 4    | 5    | /**/ | 6     | 7 | 8 | 9 | 0 | BSPC |
// | LCTRL | = | - | /    | LALT | HELD | /**/ | -     | 4 | 5 | 6 | / | =    |
// | LSHFT |   | + | *    | CALC |      | /**/ | +     | 1 | 2 | 3 | * | DEL  |
//                 | LALT | HELD | SPC  | /**/ | ENTER | , | 0 |

bindings = <
    &kp KP_NLCK  &kp KP_N1     &kp KP_N2     &kp KP_N3        &kp KP_N4            &kp KP_N5 /**/ &kp KP_N6     &kp KP_N7   &kp KP_N8  &kp KP_N9  &kp KP_N0        &kp BSPC
    &kp LCTRL    &key_summary  &kp KP_MINUS  &kp KP_DIVIDE    &kp LALT             &none     /**/ &kp KP_MINUS  &kp KP_N4   &kp KP_N5  &kp KP_N6  &kp KP_DIVIDE    &key_summary
    &kp LSHFT    &none         &kp KP_PLUS   &kp KP_MULTIPLY  &kp C_AL_CALCULATOR  &none     /**/ &kp KP_PLUS   &kp KP_N1   &kp KP_N2  &kp KP_N3  &kp KP_MULTIPLY  &kp DEL
                                             &kp LALT         &none                &kp SPACE /**/ &kp ENTER     &kp KP_DOT  &kp KP_N0
>;};